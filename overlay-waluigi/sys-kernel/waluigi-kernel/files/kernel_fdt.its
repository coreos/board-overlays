## overlay-waluigi/sys-kernel/waluigi-kernel/files/kernel_fdt.its
```
/*
 * Copyright (c) 2011 The Chromium OS Authors. All rights reserved.
 * Distributed under the terms of the GNU General Public License v2
 *
 * FIT device tree for ChromeOS ARM kernels.
 *
 * The %BUILD_ROOT% pattern will be replaced with the actual build root
 * directory while emerging the kernel.
 */

/dts-v1/;

/ {
	description = "Single Linux kernel and single FDT blob";
	#address-cells = <1>;

	images {
		kernel@1 {
			description = "ChromeOS ARM Linux kernel";
			data = /incbin/("%BUILD_ROOT%/zImage");
			type = "kernel";
			arch = "arm";
			os = "linux";
			compression = "none";
			load = <%LOAD_ADDR%>;
			entry = <%LOAD_ADDR%>;
		};
		fdt@1 {
			description = "Board Flattened Device Tree blob";
			data = /incbin/("%DEV_TREE%");
			type = "flat_dt";
			arch = "arm";
			compression = "none";
			hash@1 {
				algo = "sha1";
			};
		};
	};

	configurations {
		default = "conf@1";
		conf@1 {
			description = "The one and only";
			kernel = "kernel@1";
			fdt = "fdt@1";
		};
	};
};
```
